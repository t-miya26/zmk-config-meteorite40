## boards/shields/meteorite40/Kconfig.defconfig
```kconfig
if SHIELD_METEORITE40

config ZMK_KEYBOARD_NAME
    default "meteorite40"

endif

if SHIELD_METEORITE40_LOW

config ZMK_KEYBOARD_NAME
    default "meteorite40_low"

endif
```

## boards/shields/meteorite40/Kconfig.shield
```kconfig
config SHIELD_METEORITE40
    def_bool $(shields_list_contains,meteorite40)

config SHIELD_METEORITE40_LOW
    def_bool $(shields_list_contains,meteorite40_low)
```

## boards/shields/meteorite40_low/Kconfig.shield
```kconfig
config SHIELD_METEORITE40_LOW
    def_bool $(shields_list_contains,meteorite40_low)
```

## config/west.yml
```yaml
manifest:
  remotes:
    - name: zmkfirmware
      url-base: https://github.com/zmkfirmware
    - name: iwk7273
      url-base: https://github.com/iwk7273
  projects:
    - name: zmk
      remote: zmkfirmware
      revision: main
      import: app/west.yml
    - name: zmk-pmw3610-driver
      remote: iwk7273
      revision: main
  self:
    path: config
```

## dts/bindings/sensor/zmk,pixart-pmw3610.yaml
```yaml
# Custom binding to map the external zmk-pmw3610-driver to a unique
# compatible string while preserving the upstream properties.
description: ZMK custom PixArt PMW3610 binding

compatible: "zmk,pixart-pmw3610"

include: input/pixart,pmw3610.yaml
```
